## PR2/Kconfig.projbuild
```kconfig
menu "PRACTICE SETTINGS"

    # *********************************************************************************************************************************
    # *********************************************************************************************************************************
    # *********************************************************************************************************************************

    # Esta región es para configurar la longitud de las colas y la cantidad de flujos de trabajo.

    config QUEUE_LEN
    int "Length of queues"
    default 10
    help
        Length of sensor and filter queues.

    # config FLOW_COUNT
    # int "Total number of flows"
    # default 2
    # help
    #    A flow is composed by a sensor and a filter that will comunicate with the controllor.

    # *********************************************************************************************************************************
    # *********************************************************************************************************************************
    # *********************************************************************************************************************************

    # Esta región es para configurar el intervalo de tiempo para generar muestras y la cantidad de muestras a generar.

    config RANDOM_GEN_PERIOD
    int "Generation period"
    default 1000
    help
        Amount of milliseconds elapsed between new random numbers.

    # *********************************************************************************************************************************
    # *********************************************************************************************************************************
    # *********************************************************************************************************************************

    config AVERAGE_LEN
    int "Number coefficients"
    default 5
    help
        Size of coefficients array.

    # *********************************************************************************************************************************
    # *********************************************************************************************************************************
    # *********************************************************************************************************************************

    # Esta región es para activa la generación de estadísticas durante el tiempo de ejcución, necesarias para vTaskGetRunTimeStats().

    # Las dos configuraciones siguientes son igualmente validas.
    # Component config ==> FreeRTOS ==> [X] Enable FreeRTOS to collect run time stats
    config FREERTOS_GENERATE_RUN_TIME_STATS
    bool "Generate Run Time Stats?"
    default yes
    help
        Option needed to use vTaskGetRunTimeStats().

    # *********************************************************************************************************************************
    # *********************************************************************************************************************************
    # *********************************************************************************************************************************

endmenu
```

## PR3C/Kconfig.projbuild
```kconfig
menu "PRACTICE SETTINGS"

    # Para configurar el uso del sensor de infrarojos.

    config IR_RESET_INPUT
    bool "Use IR sensor to trigger reset"
    default yes
    help
        Use IR sensor instead of hall sensor to trigger reset. Connect to pin 14.

endmenu
```

## PR5/Kconfig.projbuild
```kconfig
menu "PRACTICE SETTINGS"

    # Para configurar el periodo de muestreo

    config SAMPLE_PERIOD
    int "Periodo de muestreo en milisegundos"
    default 1000
    range 100 100000
    help
        Ajusta el periodo de muestreo en milisegundos

endmenu
```

## PR6/Kconfig.projbuild
```kconfig
menu "PRACTICE SETTINGS"

    # Para configurar el periodo de muestreo

    config SAMPLE_PERIOD
    int "Periodo de muestreo en milisegundos"
    default 10000
    range 100 100000
    help
        Ajusta el periodo de muestreo en milisegundos

endmenu
```
